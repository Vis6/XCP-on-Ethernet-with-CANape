/* @@@@ File written by CANAPE_VERSION 17 0 31 @@@@ */ ASAP2_VERSION 1 51
/begin PROJECT xcp ""
/begin MODULE CPP ""
/begin MOD_COMMON "" BYTE_ORDER MSB_LAST ALIGNMENT_BYTE 1 ALIGNMENT_WORD 1 ALIGNMENT_LONG 1 ALIGNMENT_FLOAT32_IEEE 1 ALIGNMENT_FLOAT64_IEEE 1 /end MOD_COMMON
/begin IF_DATA XCP
 /begin PROTOCOL_LAYER 0x0100 0x07D0 0x2710 0x00 0x00 0x00 0x00 0x00 0x08 0xFF BYTE_ORDER_MSB_LAST ADDRESS_GRANULARITY_BYTE OPTIONAL_CMD ALLOC_ODT_ENTRY OPTIONAL_CMD ALLOC_ODT OPTIONAL_CMD ALLOC_DAQ OPTIONAL_CMD FREE_DAQ OPTIONAL_CMD GET_DAQ_RESOLUTION_INFO OPTIONAL_CMD GET_DAQ_PROCESSOR_INFO OPTIONAL_CMD GET_DAQ_CLOCK OPTIONAL_CMD START_STOP_SYNCH OPTIONAL_CMD START_STOP_DAQ_LIST OPTIONAL_CMD GET_DAQ_LIST_MODE OPTIONAL_CMD SET_DAQ_LIST_MODE OPTIONAL_CMD WRITE_DAQ OPTIONAL_CMD SET_DAQ_PTR OPTIONAL_CMD CLEAR_DAQ_LIST OPTIONAL_CMD UPLOAD OPTIONAL_CMD SET_MTA OPTIONAL_CMD GET_COMM_MODE_INFO /end PROTOCOL_LAYER
 /begin DAQ DYNAMIC 0x00 0x02 0x00 OPTIMISATION_TYPE_DEFAULT ADDRESS_EXTENSION_FREE IDENTIFICATION_FIELD_TYPE_ABSOLUTE GRANULARITY_ODT_ENTRY_SIZE_DAQ_BYTE 0xFE OVERLOAD_INDICATION_PID /begin TIMESTAMP_SUPPORTED 0x01 SIZE_WORD UNIT_100US /end TIMESTAMP_SUPPORTED /begin EVENT "100us" "100us" 0x00 DAQ 0xFF 0x00 0x00 0x00 /end EVENT /begin EVENT "2ms" "2ms" 0x01 DAQ 0xFF 0x00 0x06 0x00 /end EVENT /begin EVENT "10ms" "10ms" 0x02 DAQ 0xFF 0x00 0x00 0x00 /end EVENT /begin EVENT "20ms" "20ms" 0x03 DAQ 0xFF 0x00 0x06 0x00 /end EVENT /end DAQ
 /begin PAG 0x00 /end PAG
 /begin PGM PGM_MODE_ABSOLUTE 0x00 0x00 /end PGM
 /begin XCP_ON_UDP_IP 0x0100 0x07 ADDRESS "192.168.1.10" /end XCP_ON_UDP_IP
 /begin XCP_ON_CAN 0x0100 CAN_ID_MASTER 0x00 CAN_ID_SLAVE 0x00 BAUDRATE 0x07A120 SAMPLE_POINT 0x4B SAMPLE_RATE SINGLE BTL_CYCLES 0x08 SJW 0x02 SYNC_EDGE SINGLE /end XCP_ON_CAN
 /begin XCP_ON_SxI 0x0100 0x2580 ASYNCH_FULL_DUPLEX_MODE PARITY_NONE ONE_STOP_BIT HEADER_LEN_BYTE NO_CHECKSUM /end XCP_ON_SxI
/end IF_DATA
/begin MOD_PAR "" /end MOD_PAR
/begin COMPU_VTAB FRM_2 "" TAB_VERB 4 0 "Off" 1 "Silent" 2 "Pending" 3 "Running" DEFAULT_VALUE "" /end COMPU_VTAB
/begin COMPU_VTAB FRM_7 "" TAB_VERB 2 0 "Low" 100 "High" DEFAULT_VALUE "" /end COMPU_VTAB
/begin COMPU_METHOD CpuLoad.CONVERSION "" RAT_FUNC "%3.1" "%" COEFFS 0 1 0 0 0 1 /end COMPU_METHOD
/begin COMPU_METHOD CpuLoad.CONVERSIONV "@@@@RuleName created by CANape" FORM "%3.1" "" /begin FORMULA "(73424-X1)/73424*100" /end FORMULA /end COMPU_METHOD
/begin COMPU_METHOD FRM_2 "" TAB_VERB "%3.1" "" COMPU_TAB_REF FRM_2 /end COMPU_METHOD
/begin COMPU_METHOD FRM_3 "" RAT_FUNC "%3.1" "Volt" COEFFS 0 1000 0 0 0 1 /end COMPU_METHOD
/begin COMPU_METHOD FRM_4 "" RAT_FUNC "%3.1" "" COEFFS 0 100 0 0 0 1 /end COMPU_METHOD
/begin COMPU_METHOD FRM_5 "" RAT_FUNC "%3.1" "1/min" COEFFS 0 10 0 0 0 1 /end COMPU_METHOD
/begin COMPU_METHOD FRM_6 "" RAT_FUNC "%3.1" "cm" COEFFS 0 0.1 0 0 0 1 /end COMPU_METHOD
/begin COMPU_METHOD FRM_7 "" TAB_VERB "%3.1" "" COMPU_TAB_REF FRM_7 /end COMPU_METHOD
/begin COMPU_METHOD FRM_8 "" RAT_FUNC "%3.1" "Nm" COEFFS 0 10 0 0 0 1 /end COMPU_METHOD
/begin COMPU_METHOD FRM_9 "" RAT_FUNC "%3.1" "m" COEFFS 0 10 0 0 0 1 /end COMPU_METHOD
/begin COMPU_METHOD NO_FORMULA "Regel fuer Objekte ohne Umrechnungsregel" RAT_FUNC "%6.0" "" COEFFS 0 1 0 0 0 1 /end COMPU_METHOD
/begin COMPU_METHOD PWM_Level.CONVERSION "" RAT_FUNC "%3.1" "Volt" COEFFS 0 1 0 0 0 1 /end COMPU_METHOD
/begin COMPU_METHOD ulData000.CONVERSION "" RAT_FUNC "%6.2" "" COEFFS 0 1 0 0 0 1 /end COMPU_METHOD
/begin MEASUREMENT CpuLoad "" FLOAT32_IEEE CpuLoad.CONVERSIONV 0 0 0 100 /begin VIRTUAL NoInput /end VIRTUAL FORMAT "%.0" /end MEASUREMENT
/begin MEASUREMENT byte1 "Demo, read and write possible" UBYTE NO_FORMULA 0 0 0 255 READ_WRITE ECU_ADDRESS 0x1402A FORMAT "%.0" /end MEASUREMENT
/begin MEASUREMENT byte2 "Demo, read and write possible" UBYTE NO_FORMULA 0 0 0 255 READ_WRITE ECU_ADDRESS 0x1402B FORMAT "%.0" /end MEASUREMENT
/begin MEASUREMENT byte3 "Demo, read and write possible" UBYTE NO_FORMULA 0 0 0 255 READ_WRITE ECU_ADDRESS 0x1402C FORMAT "%.0" /end MEASUREMENT
/begin MEASUREMENT byte4 "Demo, read and write possible" UBYTE NO_FORMULA 0 0 0 255 READ_WRITE ECU_ADDRESS 0x1402D FORMAT "%.0" /end MEASUREMENT
/begin MEASUREMENT byteCounter "Demo signal (byte, incrementing)" UBYTE NO_FORMULA 0 0 0 255 ECU_ADDRESS 0x40000 FORMAT "%.0" /end MEASUREMENT
/begin MEASUREMENT bytePWMFilter "Filter constant for PWM filter" UBYTE NO_FORMULA 0 0 0 100 READ_WRITE ECU_ADDRESS 0x14029 FORMAT "%.0" /end MEASUREMENT
/begin CHARACTERISTIC calibration_test "" VALUE 0x1C0034 __FLOAT32_IEEE_S 100 ulData000.CONVERSION -200 200 EXTENDED_LIMITS -300 300 FORMAT "%.3" /end CHARACTERISTIC
/begin MEASUREMENT calibration_measure "calibration measurement test" FLOAT32_IEEE NO_FORMULA 0 0 -1E+12 1E+12 ECU_ADDRESS 0x1BE234 FORMAT "%.3" /end MEASUREMENT
/begin MEASUREMENT dwordCounter "Demo signal (dword, incrementing)" ULONG NO_FORMULA 0 0 0 255 READ_WRITE ECU_ADDRESS 0x40008 FORMAT "%.0" /end MEASUREMENT
/begin CHARACTERISTIC map1Counter "" VALUE 0x14046 __UBYTE 0 NO_FORMULA 0 255 FORMAT "%.0" /end CHARACTERISTIC
/begin MEASUREMENT map1InputX "" UBYTE FRM_9 0 0 0 25.5 ECU_ADDRESS 0x40034 FORMAT "%.0" /end MEASUREMENT
/begin MEASUREMENT map1InputY "" UBYTE FRM_9 0 0 0 25.5 ECU_ADDRESS 0x40033 FORMAT "%.0" /end MEASUREMENT
/begin MEASUREMENT map1Output "" UBYTE FRM_6 0 0 0 2550 ECU_ADDRESS 0x40002 FORMAT "%.0" /end MEASUREMENT
/begin CHARACTERISTIC map4_80_uc "8*8 BYTE memory layout map4_80_uc" MAP 0x14182 MapX8Y8V88ub 0 NO_FORMULA 0 255
 /begin AXIS_DESCR STD_AXIS NO_INPUT_QUANTITY NO_FORMULA 8 0 255 DEPOSIT ABSOLUTE FORMAT "%.0" /end AXIS_DESCR
 /begin AXIS_DESCR STD_AXIS NO_INPUT_QUANTITY NO_FORMULA 8 0 255 DEPOSIT ABSOLUTE FORMAT "%.0" /end AXIS_DESCR
 FORMAT "%.0" /end CHARACTERISTIC
/begin CHARACTERISTIC map5_82_uc "8*8 BYTE memory layout MapNxX8NyY8V88uc" MAP 0x141D2 MapNxXNyYVuc 0 NO_FORMULA 0 255
 /begin AXIS_DESCR STD_AXIS NO_INPUT_QUANTITY NO_FORMULA 0 0 255 DEPOSIT ABSOLUTE FORMAT "%.0" /end AXIS_DESCR
 /begin AXIS_DESCR STD_AXIS NO_INPUT_QUANTITY NO_FORMULA 0 0 255 DEPOSIT ABSOLUTE FORMAT "%.0" /end AXIS_DESCR
 FORMAT "%.0" /end CHARACTERISTIC
/begin MEASUREMENT ulData000 "" ULONG ulData000.CONVERSION 0 0 0 1000 READ_WRITE ECU_ADDRESS 0x201B3A0 FORMAT "%.0" /end MEASUREMENT
/begin MEASUREMENT ulData001 "" ULONG ulData000.CONVERSION 0 0 0 1000 READ_WRITE ECU_ADDRESS 0x201B3A4 FORMAT "%.0" /end MEASUREMENT
/begin MEASUREMENT ulData002 "" ULONG ulData000.CONVERSION 0 0 0 500 READ_WRITE ECU_ADDRESS 0x201B3A8 FORMAT "%.0" /end MEASUREMENT
/begin MEASUREMENT ulData003 "" ULONG ulData000.CONVERSION 0 0 0 255 READ_WRITE ECU_ADDRESS 0x201B3AC FORMAT "%.0" /end MEASUREMENT
/begin MEASUREMENT ulData004 "" ULONG ulData000.CONVERSION 0 0 0 255 ECU_ADDRESS 0x201B3B0 FORMAT "%.0" /end MEASUREMENT
/begin MEASUREMENT ulData005 "" ULONG ulData000.CONVERSION 0 0 0 255 ECU_ADDRESS 0x201B3B4 FORMAT "%.0" /end MEASUREMENT
/begin MEASUREMENT ulData006 "" ULONG ulData000.CONVERSION 0 0 0 255 ECU_ADDRESS 0x201B3B8 FORMAT "%.0" /end MEASUREMENT
/begin MEASUREMENT ulData007 "" ULONG ulData000.CONVERSION 0 0 0 255 ECU_ADDRESS 0x201B3BC FORMAT "%.0" /end MEASUREMENT
/begin MEASUREMENT ulData008 "" ULONG ulData000.CONVERSION 0 0 0 255 ECU_ADDRESS 0x201B3C0 FORMAT "%.0" /end MEASUREMENT
/begin MEASUREMENT ulData009 "" ULONG ulData000.CONVERSION 0 0 0 255 ECU_ADDRESS 0x201B3C4 FORMAT "%.0" /end MEASUREMENT
/begin MEASUREMENT ulData010 "" ULONG ulData000.CONVERSION 0 0 0 255 ECU_ADDRESS 0x201B3C8 FORMAT "%.0" /end MEASUREMENT
/begin MEASUREMENT ulData011 "" ULONG ulData000.CONVERSION 0 0 0 255 ECU_ADDRESS 0x201B3CC FORMAT "%.0" /end MEASUREMENT
/begin MEASUREMENT ulData012 "" ULONG ulData000.CONVERSION 0 0 0 255 ECU_ADDRESS 0x201B3D0 FORMAT "%.0" /end MEASUREMENT
/begin MEASUREMENT ulData013 "" ULONG ulData000.CONVERSION 0 0 0 255 ECU_ADDRESS 0x201B3D4 FORMAT "%.0" /end MEASUREMENT
/begin MEASUREMENT ulData014 "" ULONG ulData000.CONVERSION 0 0 0 255 ECU_ADDRESS 0x201B3D8 FORMAT "%.0" /end MEASUREMENT
/begin MEASUREMENT ulData015 "" ULONG ulData000.CONVERSION 0 0 0 255 ECU_ADDRESS 0x201B3DC FORMAT "%.0" /end MEASUREMENT
/begin MEASUREMENT ulData016 "" ULONG ulData000.CONVERSION 0 0 0 255 ECU_ADDRESS 0x201B3E0 FORMAT "%.0" /end MEASUREMENT
/begin MEASUREMENT ulData017 "" ULONG ulData000.CONVERSION 0 0 0 255 ECU_ADDRESS 0x201B3E4 FORMAT "%.0" /end MEASUREMENT
/begin MEASUREMENT ulData018 "" ULONG ulData000.CONVERSION 0 0 0 255 ECU_ADDRESS 0x201B3E8 FORMAT "%.0" /end MEASUREMENT
/begin MEASUREMENT ulData019 "" ULONG ulData000.CONVERSION 0 0 0 255 ECU_ADDRESS 0x201B3EC FORMAT "%.0" /end MEASUREMENT
/begin MEASUREMENT ulData020 "" ULONG ulData000.CONVERSION 0 0 0 255 ECU_ADDRESS 0x201B3F0 FORMAT "%.0" /end MEASUREMENT
/begin MEASUREMENT ulData021 "" ULONG ulData000.CONVERSION 0 0 0 255 ECU_ADDRESS 0x201B3F4 FORMAT "%.0" /end MEASUREMENT
/begin MEASUREMENT ulData022 "" ULONG ulData000.CONVERSION 0 0 0 255 ECU_ADDRESS 0x201B3F8 FORMAT "%.0" /end MEASUREMENT
/begin MEASUREMENT ulData023 "" ULONG ulData000.CONVERSION 0 0 0 255 ECU_ADDRESS 0x201B3FC FORMAT "%.0" /end MEASUREMENT
/begin MEASUREMENT ulData024 "" ULONG ulData000.CONVERSION 0 0 0 255 ECU_ADDRESS 0x201B400 FORMAT "%.0" /end MEASUREMENT
/begin MEASUREMENT ulData025 "" ULONG ulData000.CONVERSION 0 0 0 255 ECU_ADDRESS 0x201B404 FORMAT "%.0" /end MEASUREMENT
/begin MEASUREMENT ulData026 "" ULONG ulData000.CONVERSION 0 0 0 255 ECU_ADDRESS 0x201B408 FORMAT "%.0" /end MEASUREMENT
/begin MEASUREMENT ulData027 "" ULONG ulData000.CONVERSION 0 0 0 255 ECU_ADDRESS 0x201B40C FORMAT "%.0" /end MEASUREMENT
/begin MEASUREMENT ulData028 "" ULONG ulData000.CONVERSION 0 0 0 255 ECU_ADDRESS 0x201B410 FORMAT "%.0" /end MEASUREMENT
/begin MEASUREMENT ulData029 "" ULONG ulData000.CONVERSION 0 0 0 255 ECU_ADDRESS 0x201B414 FORMAT "%.0" /end MEASUREMENT
/begin MEASUREMENT ulData030 "" ULONG ulData000.CONVERSION 0 0 0 255 ECU_ADDRESS 0x201B418 FORMAT "%.0" /end MEASUREMENT
/begin MEASUREMENT ulData031 "" ULONG ulData000.CONVERSION 0 0 0 255 ECU_ADDRESS 0x201B41C FORMAT "%.0" /end MEASUREMENT
/begin MEASUREMENT ulData032 "" ULONG ulData000.CONVERSION 0 0 0 255 ECU_ADDRESS 0x201B420 FORMAT "%.0" /end MEASUREMENT
/begin MEASUREMENT ulData033 "" ULONG ulData000.CONVERSION 0 0 0 255 ECU_ADDRESS 0x201B424 FORMAT "%.0" /end MEASUREMENT
/begin MEASUREMENT ulData034 "" ULONG ulData000.CONVERSION 0 0 0 255 ECU_ADDRESS 0x201B428 FORMAT "%.0" /end MEASUREMENT
/begin MEASUREMENT ulData035 "" ULONG ulData000.CONVERSION 0 0 0 255 ECU_ADDRESS 0x201B42C FORMAT "%.0" /end MEASUREMENT
/begin MEASUREMENT ulData036 "" ULONG ulData000.CONVERSION 0 0 0 255 ECU_ADDRESS 0x201B430 FORMAT "%.0" /end MEASUREMENT
/begin MEASUREMENT ulData037 "" ULONG ulData000.CONVERSION 0 0 0 255 ECU_ADDRESS 0x201B434 FORMAT "%.0" /end MEASUREMENT
/begin MEASUREMENT ulData038 "" ULONG ulData000.CONVERSION 0 0 0 255 ECU_ADDRESS 0x201B438 FORMAT "%.0" /end MEASUREMENT
/begin MEASUREMENT ulData039 "" ULONG ulData000.CONVERSION 0 0 0 255 ECU_ADDRESS 0x201B43C FORMAT "%.0" /end MEASUREMENT
/begin MEASUREMENT ulData040 "" ULONG ulData000.CONVERSION 0 0 0 255 ECU_ADDRESS 0x201B440 FORMAT "%.0" /end MEASUREMENT
/begin MEASUREMENT ulData041 "" ULONG ulData000.CONVERSION 0 0 0 255 ECU_ADDRESS 0x201B444 FORMAT "%.0" /end MEASUREMENT
/begin MEASUREMENT ulData042 "" ULONG ulData000.CONVERSION 0 0 0 255 ECU_ADDRESS 0x201B448 FORMAT "%.0" /end MEASUREMENT
/begin MEASUREMENT ulData043 "" ULONG ulData000.CONVERSION 0 0 0 255 ECU_ADDRESS 0x201B44C FORMAT "%.0" /end MEASUREMENT
/begin MEASUREMENT ulData044 "" ULONG ulData000.CONVERSION 0 0 0 255 ECU_ADDRESS 0x201B450 FORMAT "%.0" /end MEASUREMENT
/begin MEASUREMENT ulData045 "" ULONG ulData000.CONVERSION 0 0 0 255 ECU_ADDRESS 0x201B454 FORMAT "%.0" /end MEASUREMENT
/begin MEASUREMENT ulData046 "" ULONG ulData000.CONVERSION 0 0 0 255 ECU_ADDRESS 0x201B458 FORMAT "%.0" /end MEASUREMENT
/begin MEASUREMENT ulData047 "" ULONG ulData000.CONVERSION 0 0 0 255 ECU_ADDRESS 0x201B45C FORMAT "%.0" /end MEASUREMENT
/begin MEASUREMENT ulData048 "" ULONG ulData000.CONVERSION 0 0 0 255 ECU_ADDRESS 0x201B460 FORMAT "%.0" /end MEASUREMENT
/begin MEASUREMENT ulData049 "" ULONG ulData000.CONVERSION 0 0 0 255 ECU_ADDRESS 0x201B464 FORMAT "%.0" /end MEASUREMENT
/begin MEASUREMENT ulData050 "" ULONG ulData000.CONVERSION 0 0 0 255 ECU_ADDRESS 0x201B468 FORMAT "%.0" /end MEASUREMENT
/begin MEASUREMENT ulData051 "" ULONG ulData000.CONVERSION 0 0 0 255 ECU_ADDRESS 0x201B46C FORMAT "%.0" /end MEASUREMENT
/begin MEASUREMENT ulData052 "" ULONG ulData000.CONVERSION 0 0 0 255 ECU_ADDRESS 0x201B470 FORMAT "%.0" /end MEASUREMENT
/begin MEASUREMENT ulData053 "" ULONG ulData000.CONVERSION 0 0 0 255 ECU_ADDRESS 0x201B474 FORMAT "%.0" /end MEASUREMENT
/begin MEASUREMENT ulData054 "" ULONG ulData000.CONVERSION 0 0 0 255 ECU_ADDRESS 0x201B478 FORMAT "%.0" /end MEASUREMENT
/begin MEASUREMENT ulData055 "" ULONG ulData000.CONVERSION 0 0 0 255 ECU_ADDRESS 0x201B47C FORMAT "%.0" /end MEASUREMENT
/begin MEASUREMENT ulData056 "" ULONG ulData000.CONVERSION 0 0 0 255 ECU_ADDRESS 0x201B480 FORMAT "%.0" /end MEASUREMENT
/begin MEASUREMENT ulData057 "" ULONG ulData000.CONVERSION 0 0 0 255 ECU_ADDRESS 0x201B484 FORMAT "%.0" /end MEASUREMENT
/begin MEASUREMENT ulData058 "" ULONG ulData000.CONVERSION 0 0 0 255 ECU_ADDRESS 0x201B488 FORMAT "%.0" /end MEASUREMENT
/begin MEASUREMENT ulData059 "" ULONG ulData000.CONVERSION 0 0 0 255 ECU_ADDRESS 0x201B48C FORMAT "%.0" /end MEASUREMENT
/begin MEASUREMENT ulData060 "" ULONG ulData000.CONVERSION 0 0 0 255 ECU_ADDRESS 0x201B490 FORMAT "%.0" /end MEASUREMENT
/begin MEASUREMENT ulData061 "" ULONG ulData000.CONVERSION 0 0 0 255 ECU_ADDRESS 0x201B494 FORMAT "%.0" /end MEASUREMENT
/begin MEASUREMENT ulData062 "" ULONG ulData000.CONVERSION 0 0 0 255 ECU_ADDRESS 0x201B498 FORMAT "%.0" /end MEASUREMENT
/begin MEASUREMENT ulData063 "" ULONG ulData000.CONVERSION 0 0 0 255 ECU_ADDRESS 0x201B49C FORMAT "%.0" /end MEASUREMENT
/begin MEASUREMENT ulData064 "" ULONG ulData000.CONVERSION 0 0 0 255 ECU_ADDRESS 0x201B4A0 FORMAT "%.0" /end MEASUREMENT
/begin MEASUREMENT ulData065 "" ULONG ulData000.CONVERSION 0 0 0 255 ECU_ADDRESS 0x201B4A4 FORMAT "%.0" /end MEASUREMENT
/begin MEASUREMENT ulData066 "" ULONG ulData000.CONVERSION 0 0 0 255 ECU_ADDRESS 0x201B4A8 FORMAT "%.0" /end MEASUREMENT
/begin MEASUREMENT ulData067 "" ULONG ulData000.CONVERSION 0 0 0 255 ECU_ADDRESS 0x201B4AC FORMAT "%.0" /end MEASUREMENT
/begin MEASUREMENT ulData068 "" ULONG ulData000.CONVERSION 0 0 0 255 ECU_ADDRESS 0x201B4B0 FORMAT "%.0" /end MEASUREMENT
/begin MEASUREMENT ulData069 "" ULONG ulData000.CONVERSION 0 0 0 255 ECU_ADDRESS 0x201B4B4 FORMAT "%.0" /end MEASUREMENT
/begin MEASUREMENT ulData070 "" ULONG ulData000.CONVERSION 0 0 0 255 ECU_ADDRESS 0x201B4B8 FORMAT "%.0" /end MEASUREMENT
/begin MEASUREMENT ulData071 "" ULONG ulData000.CONVERSION 0 0 0 255 ECU_ADDRESS 0x201B4BC FORMAT "%.0" /end MEASUREMENT
/begin MEASUREMENT ulData072 "" ULONG ulData000.CONVERSION 0 0 0 255 ECU_ADDRESS 0x201B4C0 FORMAT "%.0" /end MEASUREMENT
/begin MEASUREMENT ulData073 "" ULONG ulData000.CONVERSION 0 0 0 255 ECU_ADDRESS 0x201B4C4 FORMAT "%.0" /end MEASUREMENT
/begin MEASUREMENT ulData074 "" ULONG ulData000.CONVERSION 0 0 0 255 ECU_ADDRESS 0x201B4C8 FORMAT "%.0" /end MEASUREMENT
/begin MEASUREMENT ulData075 "" ULONG ulData000.CONVERSION 0 0 0 255 ECU_ADDRESS 0x201B4CC FORMAT "%.0" /end MEASUREMENT
/begin MEASUREMENT ulData076 "" ULONG ulData000.CONVERSION 0 0 0 255 ECU_ADDRESS 0x201B4D0 FORMAT "%.0" /end MEASUREMENT
/begin MEASUREMENT ulData077 "" ULONG ulData000.CONVERSION 0 0 0 255 ECU_ADDRESS 0x201B4D4 FORMAT "%.0" /end MEASUREMENT
/begin MEASUREMENT ulData078 "" ULONG ulData000.CONVERSION 0 0 0 255 ECU_ADDRESS 0x201B4D8 FORMAT "%.0" /end MEASUREMENT
/begin MEASUREMENT ulData079 "" ULONG ulData000.CONVERSION 0 0 0 255 ECU_ADDRESS 0x201B4DC FORMAT "%.0" /end MEASUREMENT
/begin MEASUREMENT ulData080 "" ULONG ulData000.CONVERSION 0 0 0 255 ECU_ADDRESS 0x201B4E0 FORMAT "%.0" /end MEASUREMENT
/begin MEASUREMENT ulData081 "" ULONG ulData000.CONVERSION 0 0 0 255 ECU_ADDRESS 0x201B4E4 FORMAT "%.0" /end MEASUREMENT
/begin MEASUREMENT ulData082 "" ULONG ulData000.CONVERSION 0 0 0 255 ECU_ADDRESS 0x201B4E8 FORMAT "%.0" /end MEASUREMENT
/begin MEASUREMENT ulData083 "" ULONG ulData000.CONVERSION 0 0 0 255 ECU_ADDRESS 0x201B4EC FORMAT "%.0" /end MEASUREMENT
/begin MEASUREMENT ulData084 "" ULONG ulData000.CONVERSION 0 0 0 255 ECU_ADDRESS 0x201B4F0 FORMAT "%.0" /end MEASUREMENT
/begin MEASUREMENT ulData085 "" ULONG ulData000.CONVERSION 0 0 0 255 ECU_ADDRESS 0x201B4F4 FORMAT "%.0" /end MEASUREMENT
/begin MEASUREMENT ulData086 "" ULONG ulData000.CONVERSION 0 0 0 255 ECU_ADDRESS 0x201B4F8 FORMAT "%.0" /end MEASUREMENT
/begin MEASUREMENT ulData087 "" ULONG ulData000.CONVERSION 0 0 0 255 ECU_ADDRESS 0x201B4FC FORMAT "%.0" /end MEASUREMENT
/begin MEASUREMENT ulData088 "" ULONG ulData000.CONVERSION 0 0 0 255 ECU_ADDRESS 0x201B500 FORMAT "%.0" /end MEASUREMENT
/begin MEASUREMENT ulData089 "" ULONG ulData000.CONVERSION 0 0 0 255 ECU_ADDRESS 0x201B504 FORMAT "%.0" /end MEASUREMENT
/begin MEASUREMENT ulData090 "" ULONG ulData000.CONVERSION 0 0 0 255 ECU_ADDRESS 0x201B508 FORMAT "%.0" /end MEASUREMENT
/begin MEASUREMENT ulData091 "" ULONG ulData000.CONVERSION 0 0 0 255 ECU_ADDRESS 0x201B50C FORMAT "%.0" /end MEASUREMENT
/begin MEASUREMENT ulData092 "" ULONG ulData000.CONVERSION 0 0 0 255 ECU_ADDRESS 0x201B510 FORMAT "%.0" /end MEASUREMENT
/begin MEASUREMENT ulData093 "" ULONG ulData000.CONVERSION 0 0 0 255 ECU_ADDRESS 0x201B514 FORMAT "%.0" /end MEASUREMENT
/begin MEASUREMENT ulData094 "" ULONG ulData000.CONVERSION 0 0 0 255 ECU_ADDRESS 0x201B518 FORMAT "%.0" /end MEASUREMENT
/begin MEASUREMENT ulData095 "" ULONG ulData000.CONVERSION 0 0 0 255 ECU_ADDRESS 0x201B51C FORMAT "%.0" /end MEASUREMENT
/begin MEASUREMENT ulData096 "" ULONG ulData000.CONVERSION 0 0 0 255 ECU_ADDRESS 0x201B520 FORMAT "%.0" /end MEASUREMENT
/begin MEASUREMENT ulData097 "" ULONG ulData000.CONVERSION 0 0 0 255 ECU_ADDRESS 0x201B524 FORMAT "%.0" /end MEASUREMENT
/begin MEASUREMENT ulData098 "" ULONG ulData000.CONVERSION 0 0 0 255 ECU_ADDRESS 0x201B528 FORMAT "%.0" /end MEASUREMENT
/begin MEASUREMENT ulData099 "" ULONG ulData000.CONVERSION 0 0 0 255 ECU_ADDRESS 0x201B52C FORMAT "%.0" /end MEASUREMENT
/begin MEASUREMENT ulData100 "" ULONG NO_FORMULA 0 0 0 255 ECU_ADDRESS 0x201B530 FORMAT "%.12" /end MEASUREMENT
/begin MEASUREMENT ulData101 "" ULONG NO_FORMULA 0 0 0 255 ECU_ADDRESS 0x201B534 FORMAT "%.12" /end MEASUREMENT
/begin MEASUREMENT ulData102 "" ULONG NO_FORMULA 0 0 0 255 ECU_ADDRESS 0x201B538 FORMAT "%.12" /end MEASUREMENT
/begin MEASUREMENT ulData103 "" ULONG NO_FORMULA 0 0 0 255 ECU_ADDRESS 0x201B53C FORMAT "%.12" /end MEASUREMENT
/begin MEASUREMENT ulData104 "" ULONG NO_FORMULA 0 0 0 255 ECU_ADDRESS 0x201B540 FORMAT "%.12" /end MEASUREMENT
/begin MEASUREMENT ulData105 "" ULONG NO_FORMULA 0 0 0 255 ECU_ADDRESS 0x201B544 FORMAT "%.12" /end MEASUREMENT
/begin MEASUREMENT ulData106 "" ULONG NO_FORMULA 0 0 0 255 ECU_ADDRESS 0x201B548 FORMAT "%.12" /end MEASUREMENT
/begin MEASUREMENT ulData107 "" ULONG NO_FORMULA 0 0 0 255 ECU_ADDRESS 0x201B54C FORMAT "%.12" /end MEASUREMENT
/begin MEASUREMENT ulData108 "" ULONG NO_FORMULA 0 0 0 255 ECU_ADDRESS 0x201B550 FORMAT "%.12" /end MEASUREMENT
/begin MEASUREMENT ulData109 "" ULONG NO_FORMULA 0 0 0 255 ECU_ADDRESS 0x201B554 FORMAT "%.12" /end MEASUREMENT
/begin MEASUREMENT ulData110 "" ULONG NO_FORMULA 0 0 0 255 ECU_ADDRESS 0x201B558 FORMAT "%.12" /end MEASUREMENT
/begin MEASUREMENT ulData111 "" ULONG NO_FORMULA 0 0 0 255 ECU_ADDRESS 0x201B55C FORMAT "%.12" /end MEASUREMENT
/begin MEASUREMENT ulData112 "" ULONG NO_FORMULA 0 0 0 255 ECU_ADDRESS 0x201B560 FORMAT "%.12" /end MEASUREMENT
/begin MEASUREMENT ulData113 "" ULONG NO_FORMULA 0 0 0 255 ECU_ADDRESS 0x201B564 FORMAT "%.12" /end MEASUREMENT
/begin MEASUREMENT ulData114 "" ULONG NO_FORMULA 0 0 0 255 ECU_ADDRESS 0x201B568 FORMAT "%.12" /end MEASUREMENT
/begin MEASUREMENT ulData115 "" ULONG NO_FORMULA 0 0 0 255 ECU_ADDRESS 0x201B56C FORMAT "%.12" /end MEASUREMENT
/begin MEASUREMENT ulData116 "" ULONG NO_FORMULA 0 0 0 255 ECU_ADDRESS 0x201B570 FORMAT "%.12" /end MEASUREMENT
/begin MEASUREMENT ulData117 "" ULONG NO_FORMULA 0 0 0 255 ECU_ADDRESS 0x201B574 FORMAT "%.12" /end MEASUREMENT
/begin MEASUREMENT ulData118 "" ULONG NO_FORMULA 0 0 0 255 ECU_ADDRESS 0x201B578 FORMAT "%.12" /end MEASUREMENT
/begin MEASUREMENT ulData119 "" ULONG NO_FORMULA 0 0 0 255 ECU_ADDRESS 0x201B57C FORMAT "%.12" /end MEASUREMENT
/begin MEASUREMENT ulData120 "" ULONG NO_FORMULA 0 0 0 255 ECU_ADDRESS 0x201B580 FORMAT "%.12" /end MEASUREMENT
/begin MEASUREMENT ulData121 "" ULONG NO_FORMULA 0 0 0 255 ECU_ADDRESS 0x201B584 FORMAT "%.12" /end MEASUREMENT
/begin MEASUREMENT ulData122 "" ULONG NO_FORMULA 0 0 0 255 ECU_ADDRESS 0x201B588 FORMAT "%.12" /end MEASUREMENT
/begin MEASUREMENT ulData123 "" ULONG NO_FORMULA 0 0 0 255 ECU_ADDRESS 0x201B58C FORMAT "%.12" /end MEASUREMENT
/begin MEASUREMENT ulData124 "" ULONG NO_FORMULA 0 0 0 255 ECU_ADDRESS 0x201B590 FORMAT "%.12" /end MEASUREMENT
/begin MEASUREMENT ulData125 "" ULONG NO_FORMULA 0 0 0 255 ECU_ADDRESS 0x201B594 FORMAT "%.12" /end MEASUREMENT
/begin MEASUREMENT ulData126 "" ULONG NO_FORMULA 0 0 0 255 ECU_ADDRESS 0x201B598 FORMAT "%.12" /end MEASUREMENT
/begin MEASUREMENT ulData127 "" ULONG NO_FORMULA 0 0 0 255 ECU_ADDRESS 0x201B59C FORMAT "%.12" /end MEASUREMENT
/begin MEASUREMENT ulData128 "" ULONG NO_FORMULA 0 0 0 255 ECU_ADDRESS 0x201B5A0 FORMAT "%.12" /end MEASUREMENT
/begin MEASUREMENT ulData129 "" ULONG NO_FORMULA 0 0 0 255 ECU_ADDRESS 0x201B5A4 FORMAT "%.12" /end MEASUREMENT
/begin MEASUREMENT ulData130 "" ULONG NO_FORMULA 0 0 0 255 ECU_ADDRESS 0x201B5A8 FORMAT "%.12" /end MEASUREMENT
/begin MEASUREMENT ulData131 "" ULONG NO_FORMULA 0 0 0 255 ECU_ADDRESS 0x201B5AC FORMAT "%.12" /end MEASUREMENT
/begin MEASUREMENT ulData132 "" ULONG NO_FORMULA 0 0 0 255 ECU_ADDRESS 0x201B5B0 FORMAT "%.12" /end MEASUREMENT
/begin MEASUREMENT ulData133 "" ULONG NO_FORMULA 0 0 0 255 ECU_ADDRESS 0x201B5B4 FORMAT "%.12" /end MEASUREMENT
/begin MEASUREMENT ulData134 "" ULONG NO_FORMULA 0 0 0 255 ECU_ADDRESS 0x201B5B8 FORMAT "%.12" /end MEASUREMENT
/begin MEASUREMENT ulData135 "" ULONG NO_FORMULA 0 0 0 255 ECU_ADDRESS 0x201B5BC FORMAT "%.12" /end MEASUREMENT
/begin MEASUREMENT ulData136 "" ULONG NO_FORMULA 0 0 0 255 ECU_ADDRESS 0x201B5C0 FORMAT "%.12" /end MEASUREMENT
/begin MEASUREMENT ulData137 "" ULONG NO_FORMULA 0 0 0 255 ECU_ADDRESS 0x201B5C4 FORMAT "%.12" /end MEASUREMENT
/begin MEASUREMENT ulData138 "" ULONG NO_FORMULA 0 0 0 255 ECU_ADDRESS 0x201B5C8 FORMAT "%.12" /end MEASUREMENT
/begin MEASUREMENT ulData139 "" ULONG NO_FORMULA 0 0 0 255 ECU_ADDRESS 0x201B5CC FORMAT "%.12" /end MEASUREMENT
/begin MEASUREMENT ulData140 "" ULONG NO_FORMULA 0 0 0 255 ECU_ADDRESS 0x201B5D0 FORMAT "%.12" /end MEASUREMENT
/begin MEASUREMENT ulData141 "" ULONG NO_FORMULA 0 0 0 255 ECU_ADDRESS 0x201B5D4 FORMAT "%.12" /end MEASUREMENT
/begin MEASUREMENT ulData142 "" ULONG NO_FORMULA 0 0 0 255 ECU_ADDRESS 0x201B5D8 FORMAT "%.12" /end MEASUREMENT
/begin MEASUREMENT ulData143 "" ULONG NO_FORMULA 0 0 0 255 ECU_ADDRESS 0x201B5DC FORMAT "%.12" /end MEASUREMENT
/begin MEASUREMENT ulData144 "" ULONG NO_FORMULA 0 0 0 255 ECU_ADDRESS 0x201B5E0 FORMAT "%.12" /end MEASUREMENT
/begin MEASUREMENT ulData145 "" ULONG NO_FORMULA 0 0 0 255 ECU_ADDRESS 0x201B5E4 FORMAT "%.12" /end MEASUREMENT
/begin MEASUREMENT ulData146 "" ULONG NO_FORMULA 0 0 0 255 ECU_ADDRESS 0x201B5E8 FORMAT "%.12" /end MEASUREMENT
/begin MEASUREMENT ulData147 "" ULONG NO_FORMULA 0 0 0 255 ECU_ADDRESS 0x201B5EC FORMAT "%.12" /end MEASUREMENT
/begin MEASUREMENT ulData148 "" ULONG NO_FORMULA 0 0 0 255 ECU_ADDRESS 0x201B5F0 FORMAT "%.12" /end MEASUREMENT
/begin MEASUREMENT ulData149 "" ULONG NO_FORMULA 0 0 0 255 ECU_ADDRESS 0x201B5F4 FORMAT "%.12" /end MEASUREMENT
/begin MEASUREMENT ulData150 "" ULONG NO_FORMULA 0 0 0 255 ECU_ADDRESS 0x201B5F8 FORMAT "%.12" /end MEASUREMENT
/begin MEASUREMENT ulData151 "" ULONG NO_FORMULA 0 0 0 255 ECU_ADDRESS 0x201B5FC FORMAT "%.12" /end MEASUREMENT
/begin MEASUREMENT ulData152 "" ULONG NO_FORMULA 0 0 0 255 ECU_ADDRESS 0x201B600 FORMAT "%.12" /end MEASUREMENT
/begin MEASUREMENT ulData153 "" ULONG NO_FORMULA 0 0 0 255 ECU_ADDRESS 0x201B604 FORMAT "%.12" /end MEASUREMENT
/begin MEASUREMENT ulData154 "" ULONG NO_FORMULA 0 0 0 255 ECU_ADDRESS 0x201B608 FORMAT "%.12" /end MEASUREMENT
/begin MEASUREMENT ulData155 "" ULONG NO_FORMULA 0 0 0 255 ECU_ADDRESS 0x201B60C FORMAT "%.12" /end MEASUREMENT
/begin MEASUREMENT ulData156 "" ULONG NO_FORMULA 0 0 0 255 ECU_ADDRESS 0x201B610 FORMAT "%.12" /end MEASUREMENT
/begin MEASUREMENT ulData157 "" ULONG NO_FORMULA 0 0 0 3 ECU_ADDRESS 0x201B614 FORMAT "%.12" /end MEASUREMENT
/begin MEASUREMENT ulData158 "" ULONG NO_FORMULA 0 0 0 255 ECU_ADDRESS 0x201B618 FORMAT "%.12" /end MEASUREMENT
/begin MEASUREMENT ulData159 "" ULONG NO_FORMULA 0 0 0 255 ECU_ADDRESS 0x201B61C FORMAT "%.12" /end MEASUREMENT
/begin MEASUREMENT ulData160 "" ULONG NO_FORMULA 0 0 0 255 ECU_ADDRESS 0x201B620 FORMAT "%.12" /end MEASUREMENT
/begin MEASUREMENT ulData161 "" ULONG NO_FORMULA 0 0 0 255 ECU_ADDRESS 0x201B624 FORMAT "%.12" /end MEASUREMENT
/begin MEASUREMENT ulData162 "" ULONG NO_FORMULA 0 0 0 255 ECU_ADDRESS 0x201B628 FORMAT "%.12" /end MEASUREMENT
/begin MEASUREMENT ulData163 "" ULONG NO_FORMULA 0 0 0 255 ECU_ADDRESS 0x201B62C FORMAT "%.12" /end MEASUREMENT
/begin MEASUREMENT ulData164 "" ULONG NO_FORMULA 0 0 0 255 ECU_ADDRESS 0x201B630 FORMAT "%.12" /end MEASUREMENT
/begin MEASUREMENT ulData165 "" ULONG NO_FORMULA 0 0 0 255 ECU_ADDRESS 0x201B634 FORMAT "%.12" /end MEASUREMENT
/begin MEASUREMENT ulData166 "" ULONG NO_FORMULA 0 0 0 255 ECU_ADDRESS 0x201B638 FORMAT "%.12" /end MEASUREMENT
/begin MEASUREMENT ulData167 "" ULONG NO_FORMULA 0 0 0 255 ECU_ADDRESS 0x201B63C FORMAT "%.12" /end MEASUREMENT
/begin MEASUREMENT ulData168 "" ULONG NO_FORMULA 0 0 0 255 ECU_ADDRESS 0x201B640 FORMAT "%.12" /end MEASUREMENT
/begin MEASUREMENT ulData169 "" ULONG NO_FORMULA 0 0 0 255 ECU_ADDRESS 0x201B644 FORMAT "%.12" /end MEASUREMENT
/begin MEASUREMENT ulData170 "" ULONG NO_FORMULA 0 0 0 255 ECU_ADDRESS 0x201B648 FORMAT "%.12" /end MEASUREMENT
/begin MEASUREMENT ulData171 "" ULONG NO_FORMULA 0 0 0 255 ECU_ADDRESS 0x201B64C FORMAT "%.12" /end MEASUREMENT
/begin MEASUREMENT ulData172 "" ULONG NO_FORMULA 0 0 0 255 ECU_ADDRESS 0x201B650 FORMAT "%.12" /end MEASUREMENT
/begin MEASUREMENT ulData173 "" ULONG NO_FORMULA 0 0 0 255 ECU_ADDRESS 0x201B654 FORMAT "%.12" /end MEASUREMENT
/begin MEASUREMENT ulData174 "" ULONG NO_FORMULA 0 0 0 255 ECU_ADDRESS 0x201B658 FORMAT "%.12" /end MEASUREMENT
/begin MEASUREMENT ulData175 "" ULONG NO_FORMULA 0 0 0 255 ECU_ADDRESS 0x201B65C FORMAT "%.12" /end MEASUREMENT
/begin MEASUREMENT ulData176 "" ULONG NO_FORMULA 0 0 0 255 ECU_ADDRESS 0x201B660 FORMAT "%.12" /end MEASUREMENT
/begin MEASUREMENT ulData177 "" ULONG NO_FORMULA 0 0 0 255 ECU_ADDRESS 0x201B664 FORMAT "%.12" /end MEASUREMENT
/begin MEASUREMENT ulData178 "" ULONG NO_FORMULA 0 0 0 255 ECU_ADDRESS 0x201B668 FORMAT "%.12" /end MEASUREMENT
/begin MEASUREMENT ulData179 "" ULONG NO_FORMULA 0 0 0 255 ECU_ADDRESS 0x201B66C FORMAT "%.12" /end MEASUREMENT
/begin MEASUREMENT ulData180 "" ULONG NO_FORMULA 0 0 0 255 ECU_ADDRESS 0x201B670 FORMAT "%.12" /end MEASUREMENT
/begin MEASUREMENT ulData181 "" ULONG NO_FORMULA 0 0 0 255 ECU_ADDRESS 0x201B674 FORMAT "%.12" /end MEASUREMENT
/begin MEASUREMENT ulData182 "" ULONG NO_FORMULA 0 0 0 255 ECU_ADDRESS 0x201B678 FORMAT "%.12" /end MEASUREMENT
/begin MEASUREMENT ulData183 "" ULONG NO_FORMULA 0 0 0 255 ECU_ADDRESS 0x201B67C FORMAT "%.12" /end MEASUREMENT
/begin MEASUREMENT ulData184 "" ULONG NO_FORMULA 0 0 0 255 ECU_ADDRESS 0x201B680 FORMAT "%.12" /end MEASUREMENT
/begin MEASUREMENT ulData185 "" ULONG NO_FORMULA 0 0 0 255 ECU_ADDRESS 0x201B684 FORMAT "%.12" /end MEASUREMENT
/begin MEASUREMENT ulData186 "" ULONG NO_FORMULA 0 0 0 255 ECU_ADDRESS 0x201B688 FORMAT "%.12" /end MEASUREMENT
/begin MEASUREMENT ulData187 "" ULONG NO_FORMULA 0 0 0 255 ECU_ADDRESS 0x201B68C FORMAT "%.12" /end MEASUREMENT
/begin MEASUREMENT ulData188 "" ULONG NO_FORMULA 0 0 0 255 ECU_ADDRESS 0x201B690 FORMAT "%.12" /end MEASUREMENT
/begin MEASUREMENT ulData189 "" ULONG NO_FORMULA 0 0 0 255 ECU_ADDRESS 0x201B694 FORMAT "%.12" /end MEASUREMENT
/begin MEASUREMENT ulData190 "" ULONG NO_FORMULA 0 0 0 255 ECU_ADDRESS 0x201B698 FORMAT "%.12" /end MEASUREMENT
/begin MEASUREMENT ulData191 "" ULONG NO_FORMULA 0 0 0 255 ECU_ADDRESS 0x201B69C FORMAT "%.12" /end MEASUREMENT
/begin MEASUREMENT ulData192 "" ULONG NO_FORMULA 0 0 0 255 ECU_ADDRESS 0x201B6A0 FORMAT "%.12" /end MEASUREMENT
/begin MEASUREMENT ulData193 "" ULONG NO_FORMULA 0 0 0 255 ECU_ADDRESS 0x201B6A4 FORMAT "%.12" /end MEASUREMENT
/begin MEASUREMENT ulData194 "" ULONG NO_FORMULA 0 0 0 255 ECU_ADDRESS 0x201B6A8 FORMAT "%.12" /end MEASUREMENT
/begin MEASUREMENT ulData195 "" ULONG NO_FORMULA 0 0 0 255 ECU_ADDRESS 0x201B6AC FORMAT "%.12" /end MEASUREMENT
/begin MEASUREMENT ulData196 "" ULONG NO_FORMULA 0 0 0 255 ECU_ADDRESS 0x201B6B0 FORMAT "%.12" /end MEASUREMENT
/begin MEASUREMENT ulData197 "" ULONG NO_FORMULA 0 0 0 255 ECU_ADDRESS 0x201B6B4 FORMAT "%.12" /end MEASUREMENT
/begin MEASUREMENT ulData198 "" ULONG NO_FORMULA 0 0 0 255 ECU_ADDRESS 0x201B6B8 FORMAT "%.12" /end MEASUREMENT
/begin MEASUREMENT ulData199 "" ULONG NO_FORMULA 0 0 0 255 ECU_ADDRESS 0x201B6BC FORMAT "%.12" /end MEASUREMENT
/begin MEASUREMENT ulMsCounter "" ULONG NO_FORMULA 0 0 0 10000000000 ECU_ADDRESS 0x201A820 FORMAT "%.12" /end MEASUREMENT
/begin MEASUREMENT v "Digital Filter Outputvalue" UWORD FRM_3 0 0 0 1 ECU_ADDRESS 0x40038 FORMAT "%.0" /end MEASUREMENT
/begin MEASUREMENT vin "Digital Filter Inputvalue" UWORD FRM_3 0 0 0 1 READ_WRITE ECU_ADDRESS 0x40042 FORMAT "%.0" /end MEASUREMENT
/begin MEASUREMENT wordCounter "Demo signal (word, incrementing)" UWORD NO_FORMULA 0 0 0 65535 READ_WRITE ECU_ADDRESS 0x40054 FORMAT "%.0" /end MEASUREMENT
/begin GROUP Axis "Shared Axis for Calibration Maps" /end GROUP
/begin GROUP Bits "Single Bit Values" /end GROUP
/begin GROUP Bitslices "Multibit Values" /end GROUP
/begin GROUP Curves "Calibration Curves" /end GROUP
/begin GROUP EcuSim "Kommentar" ROOT
 /begin SUB_GROUP Axis Curves Example_Filter Example_PWM Maps Measure Parameters /end SUB_GROUP
/end GROUP
/begin GROUP Example_Filter "Digital Filter v=(vin*a0+v*b0)/c0" /begin REF_MEASUREMENT v vin /end REF_MEASUREMENT /end GROUP
/begin GROUP Example_PWM "Generator for a PWM Signal" /begin SUB_GROUP PWM_Parameters PWM_Signals /end SUB_GROUP /end GROUP
/begin GROUP Maps "Calibration Maps" /begin SUB_GROUP WorkingPoint /end SUB_GROUP /begin REF_CHARACTERISTIC map4_80_uc map5_82_uc /end REF_CHARACTERISTIC /end GROUP
/begin GROUP Measure "Measurement Values" /begin SUB_GROUP Bits Bitslices Test_Signals /end SUB_GROUP /end GROUP
/begin GROUP Parameters "Calibration Parameters" /begin SUB_GROUP Test_Parameters /end SUB_GROUP /end GROUP
/begin GROUP PWM_Parameters "Parametes for PWM Example" /begin REF_MEASUREMENT bytePWMFilter /end REF_MEASUREMENT /end GROUP
/begin GROUP PWM_Signals "Measurement Signals from PWM" /end GROUP
/begin GROUP Test_Parameters "Test Parameters, BYTE" /end GROUP
/begin GROUP Test_Signals "Test Signals"
 /begin REF_MEASUREMENT byte1 byte2 byte3 byte4 byteCounter dwordCounter wordCounter /end REF_MEASUREMENT
/end GROUP
/begin GROUP WorkingPoint "Example for working point" /begin REF_CHARACTERISTIC map1Counter /end REF_CHARACTERISTIC /begin REF_MEASUREMENT map1InputX map1InputY map1Output /end REF_MEASUREMENT /end GROUP
/begin RECORD_LAYOUT __FLOAT32_IEEE FNC_VALUES 1 FLOAT32_IEEE COLUMN_DIR DIRECT /end RECORD_LAYOUT
/begin RECORD_LAYOUT __SBYTE FNC_VALUES 1 SBYTE COLUMN_DIR DIRECT /end RECORD_LAYOUT
/begin RECORD_LAYOUT __SLONG FNC_VALUES 1 SLONG COLUMN_DIR DIRECT /end RECORD_LAYOUT
/begin RECORD_LAYOUT __SWORD FNC_VALUES 1 SWORD COLUMN_DIR DIRECT /end RECORD_LAYOUT
/begin RECORD_LAYOUT __UBYTE FNC_VALUES 1 UBYTE COLUMN_DIR DIRECT /end RECORD_LAYOUT
/begin RECORD_LAYOUT __ULONG FNC_VALUES 1 ULONG COLUMN_DIR DIRECT /end RECORD_LAYOUT
/begin RECORD_LAYOUT __UWORD FNC_VALUES 1 UWORD COLUMN_DIR DIRECT /end RECORD_LAYOUT
/begin RECORD_LAYOUT _CurveNxVub FNC_VALUES 2 UBYTE ROW_DIR DIRECT NO_AXIS_PTS_X 1 UBYTE /end RECORD_LAYOUT
/begin RECORD_LAYOUT CurveNxVub AXIS_PTS_X 1 UBYTE INDEX_INCR DIRECT FNC_VALUES 2 UBYTE ROW_DIR DIRECT /end RECORD_LAYOUT
/begin RECORD_LAYOUT CurveNxXVub AXIS_PTS_X 2 UBYTE INDEX_INCR DIRECT FNC_VALUES 3 UBYTE ROW_DIR DIRECT NO_AXIS_PTS_X 1 UBYTE /end RECORD_LAYOUT
/begin RECORD_LAYOUT CurveV8ub FIX_NO_AXIS_PTS_X 8 FNC_VALUES 1 UBYTE ROW_DIR DIRECT /end RECORD_LAYOUT
/begin RECORD_LAYOUT CurveVub FNC_VALUES 1 UBYTE ROW_DIR DIRECT /end RECORD_LAYOUT
/begin RECORD_LAYOUT CurveX8ub AXIS_PTS_X 1 UBYTE INDEX_INCR DIRECT FIX_NO_AXIS_PTS_X 8 /end RECORD_LAYOUT
/begin RECORD_LAYOUT CurveX8V8ub AXIS_PTS_X 1 UBYTE INDEX_INCR DIRECT FIX_NO_AXIS_PTS_X 8 FNC_VALUES 2 UBYTE ROW_DIR DIRECT /end RECORD_LAYOUT
/begin RECORD_LAYOUT CurveX8V8ubAlternate AXIS_PTS_X 1 UWORD INDEX_INCR DIRECT FIX_NO_AXIS_PTS_X 8 FNC_VALUES 2 UWORD ALTERNATE_WITH_X DIRECT /end RECORD_LAYOUT
/begin RECORD_LAYOUT MapColRowuw FNC_VALUES 1 UWORD COLUMN_DIR DIRECT /end RECORD_LAYOUT
/begin RECORD_LAYOUT MapNxNyVub FNC_VALUES 3 UBYTE ROW_DIR DIRECT NO_AXIS_PTS_X 1 UBYTE NO_AXIS_PTS_Y 2 UBYTE /end RECORD_LAYOUT
/begin RECORD_LAYOUT MapNxNyXYVub AXIS_PTS_X 3 UBYTE INDEX_INCR DIRECT AXIS_PTS_Y 4 UBYTE INDEX_INCR DIRECT FNC_VALUES 5 UBYTE ROW_DIR DIRECT NO_AXIS_PTS_X 1 UBYTE NO_AXIS_PTS_Y 2 UBYTE /end RECORD_LAYOUT
/begin RECORD_LAYOUT MapNxXNyYVuc AXIS_PTS_X 2 UBYTE INDEX_INCR DIRECT AXIS_PTS_Y 4 UBYTE INDEX_INCR DIRECT FNC_VALUES 5 UBYTE ROW_DIR DIRECT NO_AXIS_PTS_X 1 UBYTE NO_AXIS_PTS_Y 3 UBYTE /end RECORD_LAYOUT
/begin RECORD_LAYOUT MapRowColub FNC_VALUES 1 UBYTE ROW_DIR DIRECT /end RECORD_LAYOUT
/begin RECORD_LAYOUT MapV86ub FIX_NO_AXIS_PTS_X 8 FIX_NO_AXIS_PTS_Y 6 FNC_VALUES 1 UBYTE ROW_DIR DIRECT /end RECORD_LAYOUT
/begin RECORD_LAYOUT MapX8Y6V86ub AXIS_PTS_X 1 UBYTE INDEX_INCR DIRECT AXIS_PTS_Y 2 UBYTE INDEX_INCR DIRECT FIX_NO_AXIS_PTS_X 8 FIX_NO_AXIS_PTS_Y 6 FNC_VALUES 3 UBYTE ROW_DIR DIRECT /end RECORD_LAYOUT
/begin RECORD_LAYOUT MapX8Y8V88ub AXIS_PTS_X 1 UBYTE INDEX_INCR DIRECT AXIS_PTS_Y 2 UBYTE INDEX_INCR DIRECT FIX_NO_AXIS_PTS_X 8 FIX_NO_AXIS_PTS_Y 8 FNC_VALUES 3 UBYTE ROW_DIR DIRECT /end RECORD_LAYOUT
/begin RECORD_LAYOUT MapXYVub AXIS_PTS_X 1 UBYTE INDEX_INCR DIRECT AXIS_PTS_Y 2 UBYTE INDEX_INCR DIRECT FNC_VALUES 3 UBYTE ROW_DIR DIRECT /end RECORD_LAYOUT
/begin RECORD_LAYOUT SSV__FLOAT32_IEEE AXIS_PTS_X 1 FLOAT32_IEEE INDEX_INCR DIRECT /end RECORD_LAYOUT
/begin RECORD_LAYOUT SSV__SBYTE AXIS_PTS_X 1 SBYTE INDEX_INCR DIRECT /end RECORD_LAYOUT
/begin RECORD_LAYOUT SSV__SLONG AXIS_PTS_X 1 SLONG INDEX_INCR DIRECT /end RECORD_LAYOUT
/begin RECORD_LAYOUT SSV__SWORD AXIS_PTS_X 1 SWORD INDEX_INCR DIRECT /end RECORD_LAYOUT
/begin RECORD_LAYOUT SSV__UBYTE AXIS_PTS_X 1 UBYTE INDEX_INCR DIRECT /end RECORD_LAYOUT
/begin RECORD_LAYOUT SSV__ULONG AXIS_PTS_X 1 ULONG INDEX_INCR DIRECT /end RECORD_LAYOUT
/begin RECORD_LAYOUT SSV__UWORD AXIS_PTS_X 1 UWORD INDEX_INCR DIRECT /end RECORD_LAYOUT
/begin RECORD_LAYOUT __UBYTE_Z FNC_VALUES 1 UBYTE ROW_DIR DIRECT /end RECORD_LAYOUT
/begin RECORD_LAYOUT __UWORD_Z FNC_VALUES 1 UWORD ROW_DIR DIRECT /end RECORD_LAYOUT
/begin RECORD_LAYOUT __ULONG_Z FNC_VALUES 1 ULONG ROW_DIR DIRECT /end RECORD_LAYOUT
/begin RECORD_LAYOUT __SBYTE_Z FNC_VALUES 1 SBYTE ROW_DIR DIRECT /end RECORD_LAYOUT
/begin RECORD_LAYOUT __SWORD_Z FNC_VALUES 1 SWORD ROW_DIR DIRECT /end RECORD_LAYOUT
/begin RECORD_LAYOUT __SLONG_Z FNC_VALUES 1 SLONG ROW_DIR DIRECT /end RECORD_LAYOUT
/begin RECORD_LAYOUT __FLOAT32_IEEE_Z FNC_VALUES 1 FLOAT32_IEEE ROW_DIR DIRECT /end RECORD_LAYOUT
/begin RECORD_LAYOUT __FLOAT64_IEEE_Z FNC_VALUES 1 FLOAT64_IEEE ROW_DIR DIRECT /end RECORD_LAYOUT
/begin RECORD_LAYOUT __UBYTE_S FNC_VALUES 1 UBYTE COLUMN_DIR DIRECT /end RECORD_LAYOUT
/begin RECORD_LAYOUT __UWORD_S FNC_VALUES 1 UWORD COLUMN_DIR DIRECT /end RECORD_LAYOUT
/begin RECORD_LAYOUT __ULONG_S FNC_VALUES 1 ULONG COLUMN_DIR DIRECT /end RECORD_LAYOUT
/begin RECORD_LAYOUT __SBYTE_S FNC_VALUES 1 SBYTE COLUMN_DIR DIRECT /end RECORD_LAYOUT
/begin RECORD_LAYOUT __SWORD_S FNC_VALUES 1 SWORD COLUMN_DIR DIRECT /end RECORD_LAYOUT
/begin RECORD_LAYOUT __SLONG_S FNC_VALUES 1 SLONG COLUMN_DIR DIRECT /end RECORD_LAYOUT
/begin RECORD_LAYOUT __FLOAT32_IEEE_S FNC_VALUES 1 FLOAT32_IEEE COLUMN_DIR DIRECT /end RECORD_LAYOUT
/begin RECORD_LAYOUT __FLOAT64_IEEE_S FNC_VALUES 1 FLOAT64_IEEE COLUMN_DIR DIRECT /end RECORD_LAYOUT
/begin RECORD_LAYOUT SSV__UBYTE_S AXIS_PTS_X 1 UBYTE INDEX_INCR DIRECT /end RECORD_LAYOUT
/begin RECORD_LAYOUT SSV__UWORD_S AXIS_PTS_X 1 UWORD INDEX_INCR DIRECT /end RECORD_LAYOUT
/begin RECORD_LAYOUT SSV__ULONG_S AXIS_PTS_X 1 ULONG INDEX_INCR DIRECT /end RECORD_LAYOUT
/begin RECORD_LAYOUT SSV__SBYTE_S AXIS_PTS_X 1 SBYTE INDEX_INCR DIRECT /end RECORD_LAYOUT
/begin RECORD_LAYOUT SSV__SWORD_S AXIS_PTS_X 1 SWORD INDEX_INCR DIRECT /end RECORD_LAYOUT
/begin RECORD_LAYOUT SSV__SLONG_S AXIS_PTS_X 1 SLONG INDEX_INCR DIRECT /end RECORD_LAYOUT
/begin RECORD_LAYOUT SSV__FLOAT32_IEEE_S AXIS_PTS_X 1 FLOAT32_IEEE INDEX_INCR DIRECT /end RECORD_LAYOUT
/begin RECORD_LAYOUT SSV__FLOAT64_IEEE_S AXIS_PTS_X 1 FLOAT64_IEEE INDEX_INCR DIRECT /end RECORD_LAYOUT
/end MODULE
/end PROJECT
